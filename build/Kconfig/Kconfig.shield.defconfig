## build/Kconfig/Kconfig.shield.defconfig
```kconfig
osource "C:/nordic/myApps/test/boards/shields/*/Kconfig.defconfig"
osource "C:/ncs/v3.0.2/nrf/boards/shields/*/Kconfig.defconfig"
```

## build/mcuboot/Kconfig/Kconfig.shield
```kconfig
osource "C:/nordic/myApps/test/boards/shields/*/Kconfig.shield"
osource "C:/ncs/v3.0.2/nrf/boards/shields/*/Kconfig.shield"
```

## build/mcuboot/Kconfig/boards/Kconfig.defconfig
```kconfig
# Load Zephyr board defconfig descriptions.
osource "C:/ncs/v3.0.2/nrf/boards/nordic/thingy91x/Kconfig.defconfig"
```

## build/thingy/Kconfig/Kconfig.shield
```kconfig
osource "C:/Users/MitchellLeonard/Desktop/thingy/boards/shields/*/Kconfig.shield"
osource "C:/ncs/v3.0.2/nrf/boards/shields/*/Kconfig.shield"
```

## build/thingy/Kconfig/boards/Kconfig.sysbuild
```kconfig
# Load Sysbuild board Kconfig descriptions.
osource "C:/ncs/v3.0.2/nrf/boards/nordic/thingy91x/Kconfig.sysbuild"
```

## build_1/Kconfig/Kconfig.shield.defconfig
```kconfig
osource "C:/Users/leona/Desktop/thingy/boards/shields/*/Kconfig.defconfig"
osource "C:/ncs/v3.0.2/nrf/boards/shields/*/Kconfig.defconfig"
```

## build_1/b0/Kconfig/Kconfig.shield
```kconfig
osource "C:/Users/leona/Desktop/thingy/boards/shields/*/Kconfig.shield"
osource "C:/ncs/v3.0.2/nrf/boards/shields/*/Kconfig.shield"
```

## build_1/mcuboot/Kconfig/boards/Kconfig.sysbuild
```kconfig
# Load Sysbuild board Kconfig descriptions.
osource "C:/Users/leona/Desktop/thingy/boards/kestrel_board/KalScott/Kconfig.sysbuild"
```

## build_1/thingy/Kconfig/boards/Kconfig
```kconfig
# Load Zephyr board Kconfig descriptions.
osource "C:/Users/leona/Desktop/thingy/boards/kestrel_board/KalScott/Kconfig"
```

## build_1/thingy/Kconfig/boards/Kconfig.defconfig
```kconfig
# Load Zephyr board defconfig descriptions.
osource "C:/Users/leona/Desktop/thingy/boards/kestrel_board/KalScott/Kconfig.defconfig"
```
